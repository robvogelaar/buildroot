## package/gles2apps/Config.in
```kconfig
config BR2_PACKAGE_GLES2APPS
	bool "gles2apps"
	select BR2_PACKAGE_LIBPNG
	select BR2_PACKAGE_FREETYPE
	depends on BR2_PACKAGE_HAS_OPENGL_EGL
	depends on BR2_PACKAGE_HAS_OPENGL_ES
	help
	  Gles2apps contains egl and gl|es 2.0 apps.
```

## package/qtp/Config.in
```kconfig
config BR2_PACKAGE_QTP
	bool "qtp"
	help
	  Qtp

if BR2_PACKAGE_QTP
source "package/qtp/qtpbase/Config.in"
source "package/qtp/qtpwebkit/Config.in"
endif
```

## package/qtp/qtpbase/Config.in
```kconfig
config BR2_PACKAGE_QTPBASE
	bool "qtpbase"
	select BR2_PACKAGE_ZLIB
	select BR2_PACKAGE_PCRE
	select BR2_PACKAGE_PCRE_16
	select BR2_PACKAGE_JPEG
	select BR2_PACKAGE_LIBPNG
	select BR2_PACKAGE_FREETYPE
	select BR2_PACKAGE_DBUS
	select BR2_PACKAGE_ICU
	depends on BR2_PACKAGE_HAS_OPENGL_EGL
	depends on BR2_PACKAGE_HAS_OPENGL_ES
	help
	  Qtpbase
```

## package/qtp/qtpwebkit/Config.in
```kconfig
config BR2_PACKAGE_QTPWEBKIT
	bool "qtpwebkit"
	select BR2_PACKAGE_QTPBASE
	help
	  Qtpwebkit
```
